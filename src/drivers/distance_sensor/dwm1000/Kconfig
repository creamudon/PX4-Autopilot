## src/drivers/distance_sensor/dwm1000/Kconfig
```kconfig
menuconfig DRIVERS_DISTANCE_SENSOR_DWM1000
	bool "dwm1000"
	default n
	---help---
		Enable support for dwm1000
```

## src/modules/ekf_jh/Kconfig
```kconfig
menuconfig MODULES_EKF_JH
	bool "ekf_jh"
	default n
	---help---
		Enable support for esc_battery

menuconfig USER_EKF_JH
	bool "ekf_jh running as userspace module"
	default y
	depends on BOARD_PROTECTED && MODULES_EKF_JH
	---help---
		Put ekf_jh in userspace memory
```
